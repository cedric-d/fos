## Buildroot/package/FOG/partclone/Config.in
```kconfig
config BR2_PACKAGE_PARTCLONE
	bool "partclone"
	select BR2_USE_WCHAR
	help
	  Partclone
	  The Free and Open Source Software for Partition Imaging and Cloning

	  http://partclone.org
```

## Buildroot/package/FOG/partimage/Config.in
```kconfig
config BR2_PACKAGE_PARTIMAGE
	bool "partimage"
	select BR2_PACKAGE_NTFS_3G_NTFSPROGS
	select BR2_PACKAGE_E2FSPROGS
	select BR2_PACKAGE_READLINE
	select BR2_PACKAGE_UTIL_LINUX
	select BR2_PACKAGE_UTIL_LINUX_LIBUUID
	select BR2_USE_WCHAR
	help
	  partimage, the GNU partition resizing program

	  http://www.partimage.org/Main_Page
```
